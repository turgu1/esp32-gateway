## examples/gateway-exerciser/src/Kconfig.projbuild
```kconfig
menu "Gateway Exerciser"

    choice
        prompt "Log Level"
        default EXERCISER_LOG_ERROR
        help
            Max log level used by the exerciser to report various log 
            information on the USB port.
        config EXERCISER_LOG_NONE
            bool "None"
        config EXERCISER_LOG_ERROR
            bool "Error"
        config EXERCISER_LOG_WARN
            bool "Warning"
        config EXERCISER_LOG_INFO
            bool "Info"
        config EXERCISER_LOG_DEBUG
            bool "Debug"
        config EXERCISER_LOG_VERBOSE
            bool "Verbose"
    endchoice
    
    config EXERCISER_TOPIC_SUFFIX
        string "MQTT Topic Suffix"
        default "topic_suffix"
        help
            Enter the topic suffix that will be used by the gateway to
            generate the topic to be sent to the MQTT broker.
            
    choice
        prompt "Transmission Protocol"
        default EXERCISER_ENABLE_ESP_NOW
        help
            Select the protocol to be used to transmit packets to
            the ESP32 Gateway.
        config EXERCISER_ENABLE_UDP
            bool "UDP"
        config EXERCISER_ENABLE_ESP_NOW
            bool "ESP-NOW"
    endchoice

    menu "UDP Protocol"
        depends on EXERCISER_ENABLE_UDP
        config EXERCISER_UDP_PORT
            int "UDP Port"
            default 3333
            range 0 65535
            help
                The UDP Port to be used the exerciser to transmit packets to the
                gateway.

        config EXERCISER_UDP_MAX_PKT_SIZE
            int "UDP Max Packet Size"
            default 250
            range 2 1450
            help
                The UDP maximum packet size allowed. The first 2 bytes are
                reseved for the CRC checksum.

        config EXERCISER_GATEWAY_ADDRESS
            string "Gateway Address"
            default "0.0.0.0"
            help
                Enter the Gateway address. It can be entered as a standard IPv4
                dotted decimal notation (xx.xx.xx.xx) or as a DNS name.
    endmenu

    menu "ESP-NOW Protocol"
        config EXERCISER_ESPNOW_PMK
            string "ESP-NOW primary master key"
            default "pmk1234567890123"
            help
                ESP-NOW Primary Master Key (PMK) for the exerciser and gateway
                to use. The length of the key must be 16 characters. 
                Please ensure that the key is in synch with the PMK defined in the
                gateway.

        config EXERCISER_APSSID_PREFIX
            string "Gateway AP SSID Prefix"
            default "RX"
            help
                Enter the beginning of the SSID for the gateway Access Point (AP).
                This will be used to find the AP MAC adress to transmit ESP-NOW 
                packets to the gateway.

        config EXERCISER_ENCRYPT
            bool "Encryption enabled"
            default "n"
            help
                Set if this device is using packet encryption.

        config EXERCISER_ESPNOW_LMK
            depends on EXERCISER_ENCRYPT
            string "ESP-NOW local master key"
            default "lmk1234567890123"
            help
                ESP-NOW local master key (LMK) for the exerciser
                to use. The length of LMK must be 16 characters.
                Please ensure that the key reflects the gateway configuration.

        config EXERCISER_CHANNEL
            int "Channel"
            default 1
            range 0 14
            help
                The channel to be used by the gateway. Note that it must be
                the same as defined in the WiFi router. Usual values are 1,
                6, or 11. These preferred values are to diminish potential r/f
                interference.

        config EXERCISER_ESPNOW_MAX_PKT_SIZE
            int "ESP-NOW Max Packet Size"
            default 248
            range 10 248
            help
                The ESP-NOW maximum packet size allowed without considering the CRC.
                 Cannot be larger than 248.

        config EXERCISER_ESPNOW_ENABLE_LONG_RANGE
            bool "Enable Long Range"
            default "n"
            help
                When enable long range, the PHY rate of ESP32 will be 512Kbps
                or 256Kbps
    endmenu

    menu "Wifi"
        config EXERCISER_WIFI_ESP_NOW_STA_SSID
            depends on EXERCISER_ENABLE_ESP_NOW
            string "Wifi Gateway SSID"
            default "your_wifi_gateway_ssid"
            help
                SSID associated to Wifi as defined in your gateway. Will be used 
                to find the gateway MAC address when unknown. 

        config EXERCISER_WIFI_ESP_NOW_STA_PASS
            depends on EXERCISER_ENABLE_ESP_NOW
            string "Wifi Gateway Password"
            default "your_wifi_gateway_password"
            help
                Password associated to Wifi as defined in your gateway.
                Can be empty.

        config EXERCISER_WIFI_UDP_STA_SSID
            depends on EXERCISER_ENABLE_UDP
            string "Wifi Router SSID"
            default "your_wifi_router_ssid"
            help
                Wifi SSID as defined in your router.

        config EXERCISER_WIFI_UDP_STA_PASS
            depends on EXERCISER_ENABLE_UDP
            string "Wifi Router Password"
            default "your_wifi_router_password"
            help
                Wifi Password as defined in your router.
                Can be empty.

        choice
            prompt "Wifi Gateway Authorization Mode"
            default EXERCISER_WIFI_STA_WPA2
            help
                Authorization mode as defined in your gateway.
            config EXERCISER_WIFI_STA_WPA3
                bool "WPA3"
            config EXERCISER_WIFI_STA_WPA2
                bool "WPA2"
            config EXERCISER_WIFI_STA_WPA
                bool "WPA"
            config EXERCISER_WIFI_STA_WEP
                bool "WEP"
        endchoice
    endmenu
endmenu
```

## src/Kconfig.projbuild
```kconfig
menu "ESP-32 Gateway Configuration"

    config GATEWAY_MSG_QUEUE_SIZE
        int "Message queue size"
        default 20
        range 5 50
        help
            The maximum number of messages queud in the gateway waiting
            to be sent to the MQTT server.

    choice
        prompt "Log Level"
        default GATEWAY_LOG_ERROR
        help
            Max log level used by the gateway to report various log 
            information on the USB port.
        config GATEWAY_LOG_NONE
            bool "None"
        config GATEWAY_LOG_ERROR
            bool "Error"
        config GATEWAY_LOG_WARN
            bool "Warning"
        config GATEWAY_LOG_INFO
            bool "Info"
        config GATEWAY_LOG_DEBUG
            bool "Debug"
        config GATEWAY_LOG_VERBOSE
            bool "Verbose"
    endchoice
    
    config GATEWAY_ENABLE_UDP
        bool "Enable UDP packet reception"
        default "y"
        help
            When enable, a task will wait for UDP packets for transmission
            to the MQTT broker.

    config GATEWAY_ENABLE_ESP_NOW
        bool "Enable ESP-NOW packet reception"
        default "y"
        help
            When enable, a task will wait for ESP-NOW packets for
            transmission to the MQTT broker.

    menu "UDP Protocol"
        depends on GATEWAY_ENABLE_UDP
        config GATEWAY_UDP_PORT
            int "UDP Port"
            default 3333
            range 0 65535
            help
                The UDP Port to be used by devices to transmit packets to the
                gateway.

        config GATEWAY_UDP_MAX_PKT_SIZE
            int "UDP Max Packet Size"
            default 250
            range 2 1450
            help
                The UDP maximum packet size allowed. The first 2 bytes are
                reseved for the CRC checksum.
    endmenu

    menu "ESP-NOW Protocol"
        depends on GATEWAY_ENABLE_ESP_NOW
        config GATEWAY_ESPNOW_PMK
            string "ESP-NOW Primary Master Key"
            default "pmk1234567890123"
            help
                ESP-NOW Primary Master Key (PMK) for the ESP-NOW devices and gateway
                to use. The length of the PMK must be 16 bytes.
                Please ensure that all devices are using the same PMK.

        config GATEWAY_CHANNEL
            int "Channel"
            default 1
            range 0 14
            help
                The Wifi channel to be used. Note that it must be
                the same as defined in the WiFi router. Usual values are 1,
                6, or 11. These preferred values are to diminish potential r/f
                interference.

        config GATEWAY_ESPNOW_MAX_PKT_SIZE
            int "ESP-NOW Max Packet Size"
            default 248
            range 10 248
            help
                The ESP-NOW maximum packet size allowed without considering the CRC.
                 Cannot be larger than 248.

        config GATEWAY_ESPNOW_ENABLE_LONG_RANGE
            bool "Enable Long Range"
            default "n"
            help
                When enable long range, the PHY rate of ESP32 will be 512Kbps
                or 256Kbps
    endmenu

    menu "MQTT"
        config GATEWAY_MQTT_SERVER_URI
            string "MQTT Server URI"
            default "mqtt://0.0.0.0:1883"
            help
                MQTT server URI.

        config GATEWAY_MQTT_TOPIC_PREFIX
            string "MQTT Server topic prefix"
            default "iot/"
            help
                Topic prefix to use to construct complete topic name, appending
                device's topic suffix value.

        config GATEWAY_MQTT_DEFAULT_QOS
            int "MQTT Default QOS value"
            default 0
            range 0 2
            help
                The MQTT QOS value to use when sending messages to the
                MQTT server.

        config GATEWAY_MQTT_DEFAULT_RETAIN
            int "MQTT Default Retain value"
            default 0
            range 0 1
            help
                The MQTT Retain value to use when sending messages to the
                MQTT server.

        config GATEWAY_MQTT_USERNAME
            string "MQTT Username"
            default "your_mqtt_username"
            help
                Username as defined in the MQTT server configuration.


        config GATEWAY_MQTT_CLIENT_ID
            string "MQTT Client Identification"
            default "your_mqtt_client_id"
            help
                MQTT Client Id used by the gateway.


        config GATEWAY_MQTT_PASS
            string "MQTT User Password"
            default "your_mqtt_password"
            help
                Password associated to username as defined in the MQTT server configuration.
    endmenu
    
    menu "Wifi"
        config GATEWAY_WIFI_STA_SSID
            string "Wifi Router SSID"
            default "your_wifi_router_ssid"
            help
                SSID as defined in the Wifi Router.

        config GATEWAY_WIFI_STA_PASS
            string "Wifi Router Password"
            default "your_wifi_router_password"
            help
                Password as defined in the Wifi Router.

        choice
            prompt "Wifi Router Authorization Mode"
            default GATEWAY_WIFI_STA_WPA2
            help
                Authorization mode as defined in your router.
            config GATEWAY_WIFI_STA_WPA3
                bool "WPA3"
            config GATEWAY_WIFI_STA_WPA2
                bool "WPA2"
            config GATEWAY_WIFI_STA_WPA
                bool "WPA"
            config GATEWAY_WIFI_STA_WEP
                bool "WEP"
        endchoice

        config GATEWAY_WIFI_AP_SSID
            depends on GATEWAY_ENABLE_ESP_NOW
            string "Wifi AP SSID"
            default "your_wifi_ap_ssid"
            help
                SSID associated to the gateway Wifi AP for gateway 
                discovery by sensors.

        config GATEWAY_WIFI_AP_PASS
            depends on GATEWAY_ENABLE_ESP_NOW
            string "Wifi AP Password"
            default "your_wifi_ap_password"
            help
                Password associated to the gateway Wifi AP for gateway
                discovery by sensors. Can be empty for an open AP.

        choice
            prompt "Wifi AP Authorization Mode"
            default GATEWAY_WIFI_AP_WPA2
            help
                Authorization mode to be used for the gateway AP.
            config GATEWAY_WIFI_AP_WPA3
                bool "WPA3"
            config GATEWAY_WIFI_AP_WPA2
                bool "WPA2"
            config GATEWAY_WIFI_AP_WPA
                bool "WPA"
            config GATEWAY_WIFI_AP_WEP
                bool "WEP"
        endchoice
    endmenu
endmenu
```
